## CMakeLists.txt
```
cmake_minimum_required(VERSION 3.20.0)
find_package(Zephyr REQUIRED HINTS $ENV{ZEPHYR_BASE})

# Set the board name
# Check out the docs: https://docs.zephyrproject.org/latest/develop/application/index.html#application-cmakelists-txt
set(BOARD rpi_pico)

# Set default console output (ON: USB CDC, OFF: UART)
# Check out the docs: https://docs.zephyrproject.org/latest/develop/west/build-flash-debug.html#permanent-cmake-arguments
set(USE_USB_CONSOLE ON CACHE BOOL "Enable USB CDC console")

# Setting CONF_FILE and DTC_OVERLAY_FILE
# Check out the docs: https://docs.zephyrproject.org/latest/build/kconfig/setting.html#the-initial-configuration
# Check out the docs: https://docs.zephyrproject.org/latest/build/dts/howtos.html#set-devicetree-overlays
if(EXISTS "${CMAKE_CURRENT_SOURCE_DIR}/prj.conf")
  list(APPEND CONF_FILE "prj.conf")
endif()

if(USE_USB_CONSOLE)
  message("-- The console output set to USB")
  list(APPEND CONF_FILE "usb.conf")

  if(EXISTS "${CMAKE_CURRENT_SOURCE_DIR}/app.overlay")
    list(APPEND DTC_OVERLAY_FILE "app.overlay")
  endif()
  list(APPEND DTC_OVERLAY_FILE "usb.overlay")
else()
  message("-- The console output set to UART")
endif()

project(paper_dispenser_zephyr)

#list(APPEND CMAKE_MODULE_PATH "${CMAKE_CURRENT_SOURCE_DIR}/../deps/cmake_utils")
# include(cmake_utils)

include_directories(libs/interfaces/indicator/inc)
include_directories(libs/interfaces/trigger/inc)
include_directories(inc)

set(libs_dir libs/interfaces)
file(
    GLOB_RECURSE
    interface_files
    CONFIGURE_DEPENDS
    "${libs_dir}/*.[cC]")

if(CONFIG_BUTTON_TRIGGER)
  list(APPEND app_sources src/button_trigger.c)
elseif(CONFIG_TIMER_TRIGGER)
  list(APPEND app_sources src/timer_trigger.c)
endif()

message(STATUS "-------------------------> interface_files: ${interface_files}")

target_sources(app 
                PRIVATE 
                ${app_sources} 
                ${interface_files} 
                src/main.c 
                src/led_indicator.c
                )
```

## Kconfig
```
# Copyright (c) 2024 Rodrigo Peixoto <rodrigopex@gmail.com>
# SPDX-License-Identifier: Apache-2.0

choice
	prompt "Trigger module implementation"
	optional

config TIMER_TRIGGER
	bool "The timer trigger will activate the trigger from time to time."

config BUTTON_TRIGGER
	bool "The button trigger will activate the trigger whenever the user presses the button."
	select GPIO

endchoice

module = APP
module-str = app
source "subsys/logging/Kconfig.template.log_config"

source "Kconfig.zephyr"
```

## sample.yaml
```
# sample:
#   description: Hello World sample, the simplest Zephyr
#     application
#   name: hello world
# common:
#   tags: introduction
#   integration_platforms:
#     - native_sim
#   harness: console
#   harness_config:
#     type: one_line
#     regex:
#       - "Hello World! (.*)"
# tests:
#   sample.basic.helloworld:
#     tags: introduction

sample:
  name: Button Sample
tests:
  sample.basic.button:
    tags:
      - button
      - gpio
    filter: dt_enabled_alias_with_parent_compat("sw0", "gpio-keys")
    integration_platforms:
      - nrf52833dk_nrf52820
    depends_on: gpio
    harness: button
```

## west.yml
```
manifest:
  version: 0.7
 
  defaults:
    remote: zephyrproject
  remotes:
    - name: cmake_utils_repo
      url-base: https://github.com/xsession
    - name: zephyrproject
      url-base: https://github.com/zephyrproject-rtos
    - name: mcutools
      url-base: https://github.com/mcu-tools

  projects:
    - name: zephyr
      repo-path: zephyr
      remote: zephyrproject
      revision: main
      import:
        path-prefix: deps
      path: zephyr
    
    - name: mcuboot
      remote: mcutools
      repo-path: mcuboot
      revision: v1.7.2
      path: deps/mcuboot

    - name: cmake_utils
      remote: cmake_utils_repo
      repo-path: cmake_utils
      revision: main
      path: deps/cmake_utils
 
  self:
    path: app
```

## prj.conf
```kconfig
CONFIG_LOG=y
CONFIG_APP_LOG_LEVEL_INF=y
CONFIG_ASSERT=y

CONFIG_ZBUS=y
CONFIG_ZBUS_CHANNEL_NAME=y
CONFIG_ZBUS_MSG_SUBSCRIBER=y
# CONFIG_HEAP_MEM_POOL_SIZE=1024
CONFIG_HEAP_MEM_POOL_SIZE=4096

CONFIG_SHELL=y
CONFIG_SHELL_THREAD_PRIORITY=5
CONFIG_SHELL_THREAD_PRIORITY_OVERRIDE=y
```

## src/main.c
```c
// #include <stdio.h>

// int main(void)
// {
// 	printf("Hello World! %s\n", CONFIG_BOARD);

// 	return 0;
// }


#include <zephyr/zbus/zbus.h>

#include "indicator.h"
#include "trigger.h"

#include <zephyr/logging/log.h>

LOG_MODULE_REGISTER(app, CONFIG_APP_LOG_LEVEL);

ZBUS_MSG_SUBSCRIBER_DEFINE(msub_post);

ZBUS_CHAN_ADD_OBS(chan_indicator_event, msub_post, 3);
ZBUS_CHAN_ADD_OBS(chan_trigger_event, msub_post, 3);

int main(void)
{
	int system_status = 0;

	union {
		struct msg_trigger_event trigger_evt;
		struct msg_indicator_event indicator_evt;
	} msg;

	const struct zbus_channel *chan;

	while (1) {
		zbus_sub_wait_msg(&msub_post, &chan, &msg, K_FOREVER);

		if (chan == &chan_indicator_event) {

			if (msg.indicator_evt.type == INDICATOR_EVENT_READY) {
				++system_status;

				LOG_INF("Indicator module...[ok]");
			} else {
				LOG_WRN("Indicator module...[failed: %d]",
					msg.indicator_evt.error.code);
			}
		} else if (chan == &chan_trigger_event) {

			if (msg.trigger_evt.type == TRIGGER_EVENT_READY) {
				++system_status;
				LOG_INF("Trigger module...[ok]");

			} else {
				LOG_WRN("Trigger module...[failed: %d]\n",
					msg.indicator_evt.error.code);
			}
		}

		if (system_status == 2) {
			zbus_obs_set_enable(&msub_post, false);

			break;
		}
	}

	return 0;
}
```

## src/button_trigger.c
```c
#include <zephyr/kernel.h>
#include <zephyr/device.h>
#include <zephyr/drivers/gpio.h>
#include <zephyr/sys/util.h>
#include <inttypes.h>
#include <zephyr/logging/log.h>
#include <zephyr/zbus/zbus.h>

#include "trigger.h"

LOG_MODULE_DECLARE(app, CONFIG_APP_LOG_LEVEL);

/*
 * Get button configuration from the devicetree sw0 alias. This is mandatory.
 */
#define SW0_NODE DT_ALIAS(sw0)
#if !DT_NODE_HAS_STATUS(SW0_NODE, okay)
#error "Unsupported board: sw0 devicetree alias is not defined"
#endif

static const struct gpio_dt_spec button = GPIO_DT_SPEC_GET_OR(SW0_NODE, gpios, {0});
static struct gpio_callback button_cb_data;

void button_pressed(const struct device *dev, struct gpio_callback *cb, uint32_t pins)
{
	LOG_INF("Button pressed at %" PRIu32, k_cycle_get_32());

	zbus_chan_pub(&chan_trigger_event, MSG_TRIGGER_EVT(.type = TRIGGER_EVENT_ACTIVATED),
		      K_NO_WAIT);
}

void button_thread(void)
{
	int err;

	if (!gpio_is_ready_dt(&button)) {
		zbus_chan_pub(
			&chan_trigger_event,
			MSG_TRIGGER_EVT(.type = TRIGGER_EVENT_FAILED, .error = {.code = -ENODEV}),
			K_MSEC(500));

		return;
	}

	err = gpio_pin_configure_dt(&button, GPIO_INPUT);
	if (err != 0) {
		zbus_chan_pub(&chan_trigger_event,
			      MSG_TRIGGER_EVT(.type = TRIGGER_EVENT_FAILED, .error = {.code = err}),
			      K_MSEC(500));

		return;
	}

	err = gpio_pin_interrupt_configure_dt(&button, GPIO_INT_EDGE_TO_ACTIVE);
	if (err != 0) {
		zbus_chan_pub(&chan_trigger_event,
			      MSG_TRIGGER_EVT(.type = TRIGGER_EVENT_FAILED, .error = {.code = err}),
			      K_MSEC(500));

		return;
	}

	gpio_init_callback(&button_cb_data, button_pressed, BIT(button.pin));

	gpio_add_callback(button.port, &button_cb_data);

	LOG_INF("Set up button at %s pin %d", button.port->name, button.pin);

	zbus_chan_pub(&chan_trigger_event, MSG_TRIGGER_EVT(.type = TRIGGER_EVENT_READY),
		      K_MSEC(500));
}

K_THREAD_DEFINE(button_thread_id, 1024, button_thread, NULL, NULL, NULL, 3, 0, 0);
```

## src/led_indicator.c
```c
#include <zephyr/kernel.h>
#include <zephyr/device.h>
#include <zephyr/drivers/gpio.h>
#include <zephyr/sys/util.h>
#include <zephyr/logging/log.h>

#include "indicator.h"
#include "trigger.h"

LOG_MODULE_DECLARE(app, CONFIG_APP_LOG_LEVEL);

static struct {
	struct gpio_dt_spec led;
	bool is_on;
	int pulse_duration;
} self = {.led = GPIO_DT_SPEC_GET_OR(DT_ALIAS(led0), gpios, {0}),
	  .is_on = false,
	  .pulse_duration = 100};

ZBUS_MSG_SUBSCRIBER_DEFINE(msub_led_indicator);

ZBUS_CHAN_ADD_OBS(chan_trigger_event, msub_led_indicator, 3);
ZBUS_CHAN_ADD_OBS(chan_indicator_command, msub_led_indicator, 3);

static inline void update_led_state(void)
{
	gpio_pin_set_dt(&self.led, self.is_on);
}

static inline void toggle(void)
{
	self.is_on = !self.is_on;
	update_led_state();
}

static inline void pulse(void)
{
	toggle();
	k_msleep(self.pulse_duration);
	toggle();
}

void led_thread(void)
{
	int err;

	if (self.led.port && !gpio_is_ready_dt(&self.led)) {
		zbus_chan_pub(&chan_indicator_event,
			      MSG_INDICATOR_EVT(.type = INDICATOR_EVENT_FAILED,
						.error = {.code = -ENODEV}),
			      K_MSEC(500));

		return;
	}

	err = gpio_pin_configure_dt(&self.led, GPIO_OUTPUT);
	if (err != 0) {
		zbus_chan_pub(
			&chan_indicator_event,
			MSG_INDICATOR_EVT(.type = INDICATOR_EVENT_FAILED, .error = {.code = err}),
			K_MSEC(500));

		return;
	}

	gpio_pin_set_dt(&self.led, 0);

	LOG_INF("Set up LED at %s pin %d", self.led.port->name, self.led.pin);

	zbus_chan_pub(&chan_indicator_event, MSG_INDICATOR_EVT(.type = INDICATOR_EVENT_READY),
		      K_MSEC(500));

	const struct zbus_channel *chan;

	union {
		struct msg_indicator_command indicator_cmd;
		struct msg_trigger_event trigger_evt;
	} msg;

	zbus_obs_attach_to_thread(&msub_led_indicator);

	while (1) {
		zbus_sub_wait_msg(&msub_led_indicator, &chan, &msg, K_FOREVER);
		if (chan == &chan_trigger_event) {
			switch (msg.trigger_evt.type) {
			case TRIGGER_EVENT_ACTIVATED:
				pulse();
				break;
			default:
				/* Trigger event discarded */
				break;
			}

		} else if (chan == &chan_indicator_command) {
			switch (msg.indicator_cmd.type) {
			case INDICATOR_CMD_OFF:
				self.is_on = false;
				update_led_state();
				break;
			case INDICATOR_CMD_ON:
				self.is_on = true;
				update_led_state();
				break;
			case INDICATOR_CMD_TOGGLE:
				toggle();
				break;
			case INDICATOR_CMD_PULSE:
				pulse();
				break;
			case INDICATOR_CMD_GET_PULSE_DURATION: {
				zbus_chan_pub(
					&chan_indicator_response,
					MSG_INDICATOR_RSP(.type = INDICATOR_RSP_PULSE_DURATION,
							  .pulse = {.duration =
									    self.pulse_duration}),
					K_MSEC(250));
				break;
			}
			case INDICATOR_CMD_SET_PULSE_DURATION: {
				self.pulse_duration = msg.indicator_cmd.pulse.duration;
				zbus_chan_pub(
					&chan_indicator_response,
					MSG_INDICATOR_RSP(.type = INDICATOR_RSP_PULSE_DURATION,
							  .pulse = {.duration =
									    self.pulse_duration}),
					K_MSEC(250));
				break;
			}
			default:
				LOG_ERR("Indicator action invalid");
			}
		}
	}
}

K_THREAD_DEFINE(led_thread_id, 1024, led_thread, NULL, NULL, NULL, 4, 0, 0);
```

## src/timer_trigger.c
```c
#include <zephyr/kernel.h>
#include <zephyr/zbus/zbus.h>

#include "trigger.h"

struct msg_timer_trigger_settings {
	int timeout;
};

void timer_trigger_handler(struct k_timer *dummy)
{
	zbus_chan_pub(&chan_trigger_event, MSG_TRIGGER_EVT(.type = TRIGGER_EVENT_ACTIVATED),
		      K_NO_WAIT);
}

K_TIMER_DEFINE(timer_trigger, timer_trigger_handler, NULL);

void timer_trigger_timout_lis_callback(const struct zbus_channel *chan)
{
	const struct msg_timer_trigger_settings *timer_settings = zbus_chan_const_msg(chan);

	k_timer_start(&timer_trigger, K_MSEC(timer_settings->timeout),
		      K_MSEC(timer_settings->timeout));
}

ZBUS_LISTENER_DEFINE(lis_timer_trigger, timer_trigger_timout_lis_callback);

ZBUS_CHAN_DEFINE(chan_timer_trigger_settings, struct msg_timer_trigger_settings, NULL, NULL,
		 ZBUS_OBSERVERS(lis_timer_trigger), ZBUS_MSG_INIT(.timeout = 1000));

int timer_trigger_init(void)
{
	timer_trigger_timout_lis_callback(&chan_timer_trigger_settings);

	zbus_chan_pub(&chan_trigger_event, MSG_TRIGGER_EVT(.type = TRIGGER_EVENT_READY), K_NO_WAIT);

	return 0;
}
SYS_INIT(timer_trigger_init, APPLICATION, 99);

#if defined(CONFIG_SHELL)
#include <stdlib.h>
#include <zephyr/shell/shell.h>

#define ZBUS_CHAN_LOCK(_chan, _timeout, _err)                                                      \
	for (int i = 0, e = zbus_chan_claim(_chan, _timeout); e == 0 && i == 0;                    \
	     zbus_chan_finish(_chan), *(_err) = e, ++i)

static int trigger_timeout_get_cmd_handler(const struct shell *sh, size_t argc, char **argv,
					   void *data)
{
	int err;
	struct msg_timer_trigger_settings timer_settings;

	err = zbus_chan_read(&chan_timer_trigger_settings, &timer_settings, K_MSEC(500));
	if (err) {
		shell_error(sh, "Could not retrieve the trigger timeout");

		return err;
	}

	shell_print(sh, "Timer trigger timeout: %d", timer_settings.timeout);

	return 0;
}

static int trigger_timeout_set_cmd_handler(const struct shell *sh, size_t argc, char **argv,
					   void *data)
{
	int err;

	ZBUS_CHAN_LOCK(&chan_timer_trigger_settings, K_MSEC(250), &err)
	{
		struct msg_timer_trigger_settings *timer_settings =
			zbus_chan_msg(&chan_timer_trigger_settings);

		timer_settings->timeout = atoi(argv[1]);
	}

	if (err) {
		shell_error(sh, "Could not set the timeout value");

		return err;
	} else {
		zbus_chan_notify(&chan_timer_trigger_settings, K_MSEC(250));
	}

	return 0;
}

SHELL_STATIC_SUBCMD_SET_CREATE(sub_trigger_timeout,
			       SHELL_CMD(get_timeout, NULL, "Get trigger timeout.",
					 trigger_timeout_get_cmd_handler),
			       SHELL_CMD_ARG(set_timeout, NULL, "Set trigger timeout",
					     trigger_timeout_set_cmd_handler, 2, 0),
			       SHELL_SUBCMD_SET_END);

SHELL_CMD_REGISTER(trigger_timer, &sub_trigger_timeout, "Trigger timer settings", NULL);
#endif /* CONFIG_SHELL */
```
